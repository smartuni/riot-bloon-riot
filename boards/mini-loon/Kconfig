## boards/mini-loon/Kconfig
```kconfig
# Copyright (c) 2020 HAW Hamburg
#
# This file is subject to the terms and conditions of the GNU Lesser
# General Public License v2.1. See the file LICENSE in the top level
# directory for more details.

config BOARD
    default "mini-loon" if BOARD_MINI_LOON

config BOARD_MINI_LOON
    bool
    default y
    select BOARD_COMMON_ESP32
    select CPU_MODEL_ESP32_WROOM_32
    select HAS_ARDUINO
    select HAS_PERIPH_ADC
    select HAS_PERIPH_DAC
    select HAS_PERIPH_I2C
    select HAS_PERIPH_PWM
    select HAS_PERIPH_SPI

source "$(RIOTBOARD)/common/esp32/Kconfig"
```
